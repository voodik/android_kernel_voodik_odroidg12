// SPDX-License-Identifier: (GPL-2.0+ OR MIT)
/*
 * Copyright (c) 2019 BayLibre SAS. All rights reserved.
 */

/dts-v1/;
/plugin/;


/ {
  fragment@101 {
        target-path = "/";
        __overlay__ {
                reserved-memory {
                        #address-cells = <2>;
                        #size-cells = <2>;
                        ramoops@d000000 {
                                compatible = "ramoops";
                                reg = <0x0 0x0d000000 0x0 0x00100000>;
                                record-size = <0x8000>;
                                console-size = <0x8000>;
                                ftrace-size = <0x0>;
                                pmsg-size = <0x8000>;
                        };
                };

        };
  };
  fragment@102 {
        target = <&sd_emmc_b>;
        __overlay__ {
                max-frequency = <200000000>;
                sd-uhs-sdr12;
                sd-uhs-sdr25;
                sd-uhs-sdr50;
                sd-uhs-sdr104;
        };
  };
};

