// SPDX-License-Identifier: (GPL-2.0+ OR MIT)
/*
 * Copyright (c) 2019 BayLibre SAS. All rights reserved.
 */

/dts-v1/;
/plugin/;

#include <dt-bindings/phy/phy.h>
#include <dt-bindings/gpio/gpio.h>
#include <dt-bindings/gpio/meson-g12a-gpio.h>
#include <dt-bindings/input/input.h>
#include <dt-bindings/interrupt-controller/irq.h>
#include <dt-bindings/pwm/pwm.h>

/ {
  fragment@0 {
          target = <&i2c3>;
          __overlay__ {
                  #address-cells = <1>;
                  #size-cells = <0>;
                  status = "okay";
                  clock-frequency = <400000>; /* default 400k */

                  touch: gt9xx@14 {
                          compatible = "goodix,gt911";
                          status = "okay";
                          reg = <0x14>;
                          interrupt-parent = <&gpio_intc>;
                          interrupts = <79 IRQ_TYPE_LEVEL_HIGH>;
                          reset-gpios = <&gpio GPIOX_15 GPIO_ACTIVE_HIGH>;
                          irq-gpios = <&gpio GPIOX_14 GPIO_ACTIVE_HIGH>;
                  };
          };
  };
};
