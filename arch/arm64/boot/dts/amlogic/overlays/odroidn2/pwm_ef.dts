// SPDX-License-Identifier: (GPL-2.0+ OR MIT)
/*
 * Copyright (c) 2019 BayLibre SAS. All rights reserved.
 */

/dts-v1/;
/plugin/;

/ {
  fragment@0 {
          target = <&pwm_ef>;
          __overlay__ {
                  pinctrl-0 = <&pwm_e_pins>;
                  pinctrl-names = "default";
                  #pwm-cells = <0x03>;
                  status = "okay";
          };
  };
};
