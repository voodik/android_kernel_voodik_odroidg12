/dts-v1/;
/plugin/;

/ {
	fragment@0 {
		// pwm_ef
		// This activates pwm_ef.
		target = <&pwm_ef>;

		__overlay__ {
			status = "okay";
			pinctrl-names = "pwm_pins", "gpio_periphs";
			pinctrl-0 = <&pwm_e_pins &pwm_f_pins1>;
			pinctrl-1 = <&pwmef_to_gpios>;
		};
	};
};
