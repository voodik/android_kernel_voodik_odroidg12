/dts-v1/;
/plugin/;

#include <dt-bindings/gpio/meson-g12a-gpio.h>
#include <dt-bindings/gpio/gpio.h>

/ {
	fragment@0 {
		// i2c3 aliased with i2c1.
		target = <&i2c3>;

		__overlay__ {
			status = "okay";

			#address-cells = <1>;
			#size-cells = <0>;

			/* Hardkernel I2C 3.5" Touchscreen */
			/* drivers/input/sx8650.c */
			sx865x: sx865x@49	{
				status = "okay";
				compatible = "semtech,sx8650";
				reg = <0x49>;
				#clock-cells = <0>;

				/* H/W Pin control setup */
				/* ODROID-C4 */
				gpio-pendown = <&gpio GPIOH_5 GPIO_ACTIVE_LOW>;
				gpio-reset   = <&gpio GPIOH_7 GPIO_ACTIVE_LOW>;

				/* platform data setup */
				invert-x = <0>;
				invert-y = <1>;
				swap-xy = <1>;
			};
		};
	};
};

