/dts-v1/;
/plugin/;

/ {
	fragment@0 {
		// pwm_ab
		// This activates pwm_ab.
		target = <&pwm_ab>;

		__overlay__ {
			status = "okay";
			pinctrl-names = "pwm_pins", "gpio_periphs";
			pinctrl-0 = <&pwm_a_pins &pwm_b_pins2>;
			pinctrl-1 = <&pwmab_to_gpios>;
		};
	};
};
