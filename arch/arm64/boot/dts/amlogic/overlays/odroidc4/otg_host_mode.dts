/*
 * arch/arm64/boot/dts/amlogic/overlays/odroidc4/otg_host_mode.dts
 *
 * Copyright (C) 2017 Amlogic, Inc. All rights reserved.
 *
 * This program is free software; you can redistribute it and/or modify
 * it under the terms of the GNU General Public License as published by
 * the Free Software Foundation; either version 2 of the License, or
 * (at your option) any later version.
 *
 * This program is distributed in the hope that it will be useful, but WITHOUT
 * ANY WARRANTY; without even the implied warranty of MERCHANTABILITY or
 * FITNESS FOR A PARTICULAR PURPOSE.  See the GNU General Public License for
 * more details.
 *
 */

/dts-v1/;
/plugin/;

/{
	fragment@0 {
		target = <&usb3_phy_v2>;

		__overlay__ {
			status = "okay";
			portnum = <1>;
			otg = <0>;
			gpio-vbus-power;
			gpios;
		};
	};
};
