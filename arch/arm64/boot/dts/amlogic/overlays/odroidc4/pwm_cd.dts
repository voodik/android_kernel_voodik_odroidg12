/dts-v1/;
/plugin/;

/ {
	fragment@0 {
		// pwm_cd
		// This activates pwm_cd.
		target = <&pwm_cd>;

		__overlay__ {
			status = "okay";
			pinctrl-names = "pwm_pins", "gpio_periphs";
			pinctrl-0 = <&pwm_c_pins2 &pwm_d_pins1>;
			pinctrl-1 = <&pwmcd_to_gpios>;
		};
	};
};
