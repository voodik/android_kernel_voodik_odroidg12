## drivers/amlogic/bridge/Kconfig
```kconfig
config DRM_LT8619C_QC4011
	tristate "LT8619c HDMI to LVDS Converter"
	depends on OF
	select REGMAP_I2C
	---help---
	  lt8619c chip driver.
```

## drivers/hardkernel/Kconfig
```kconfig
menu "ODROID Specific Hardware"

config ODROIDN2_SYSFS
	bool "Hardkernel ODROID-N2 sysfs Support"
	default y
	help
	   Hardkernel sysfs
endmenu
```

## sound/soc/amlogic/auge/Kconfig
```kconfig
menuconfig AMLOGIC_SND_SOC_AUGE
	bool "Amlogic Auge ASoC"
	select SND_SOC_PCM5102A
	default n
	help
		Say Y or M if you want to add support for codecs attached to
		the Amlogic Asoc interface. You will also need
		to select the audio interfaces to support below.
```
